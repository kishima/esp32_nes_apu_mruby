## sdkconfig.defaults
```kconfig
# from R2P2-ESP32
CONFIG_FATFS_LFN_HEAP=y
CONFIG_ESP_MAIN_TASK_STACK_SIZE=8192

# for DRAM overflow issue
CONFIG_ESP_WIFI_ENABLED=n

# SPI-RAM
CONFIG_SPIRAM=y
CONFIG_SPIRAM_USE_CAPS_ALLOC=y
# CONFIG_SPIRAM_USE_MALLOC is not set
CONFIG_SPIRAM_TRY_ALLOCATE_WIFI_LWIP=y

# other
CONFIG_FREERTOS_HZ=1000
CONFIG_OPTIMIZATION_LEVEL_RELEASE=y

CONFIG_ESP_DEFAULT_CPU_FREQ_MHZ_240=y
CONFIG_ESP_DEFAULT_CPU_FREQ_MHZ=240

CONFIG_ESP_MAIN_TASK_AFFINITY_CPU0=y

CONFIG_PM_ENABLE=n

# Performance optimizations (Arduino-compatible)
CONFIG_COMPILER_OPTIMIZATION_PERF=y
CONFIG_COMPILER_OPTIMIZATION_ASSERTIONS_DISABLE=y

# Flash
CONFIG_ESPTOOLPY_FLASHMODE="qio"
CONFIG_ESPTOOLPY_FLASHMODE_QIO=y
CONFIG_ESPTOOLPY_FLASHFREQ="80m"
CONFIG_ESPTOOLPY_FLASHFREQ_80M=y
CONFIG_ESPTOOLPY_FLASHSIZE="4MB"
CONFIG_ESPTOOLPY_FLASHSIZE_4MB=y

# Reduce logging overhead
CONFIG_LOG_DEFAULT_LEVEL_WARN=y
CONFIG_LOG_DEFAULT_LEVEL=2

CONFIG_SPIFFS_MAX_PARTITIONS=3
CONFIG_VFS_SUPPORT_IO=y
CONFIG_PARTITION_TABLE_CUSTOM=y

# Bluetooth Configuration - Disabled for APU-only build
CONFIG_BT_ENABLED=n

# Arduino-compatible performance settings
# FreeRTOS optimizations matching Arduino
CONFIG_FREERTOS_IDLE_TASK_STACKSIZE=1024
CONFIG_FREERTOS_WATCHPOINT_END_OF_STACK=y
CONFIG_FREERTOS_USE_TICKLESS_IDLE=n

# SPI driver optimizations for real-time performance
CONFIG_SPI_MASTER_ISR_IN_IRAM=y
CONFIG_SPI_SLAVE_ISR_IN_IRAM=y

# Memory management for emulation performance
CONFIG_MAIN_TASK_STACK_SIZE=4096
CONFIG_TIMER_TASK_STACK_SIZE=4096
CONFIG_ESP32_PTHREAD_TASK_STACK_SIZE_DEFAULT=2048

# Enable C++ exceptions for compatibility (if needed by emu core)
CONFIG_COMPILER_CXX_EXCEPTIONS=n

# Light heap poisoning for debugging without major perf hit
CONFIG_HEAP_POISONING_LIGHT=y

# Task watchdog optimized for real-time emulation
CONFIG_TASK_WDT=y
CONFIG_TASK_WDT_PANIC=y
CONFIG_TASK_WDT_TIMEOUT_S=5
CONFIG_TASK_WDT_CHECK_IDLE_TASK_CPU0=y

# Interrupt watchdog settings matching Arduino
CONFIG_INT_WDT=y
CONFIG_INT_WDT_TIMEOUT_MS=300
CONFIG_INT_WDT_CHECK_CPU1=y

# Enable PSRAM support (commented out but available for future use)
# CONFIG_SPIRAM_SUPPORT=y
# CONFIG_SPIRAM_BOOT_INIT=y
# CONFIG_SPIRAM_USE_CAPS_ALLOC=y
# CONFIG_SPIRAM_SPEED_40M=y
# CONFIG_SPIRAM_CACHE_WORKAROUND=y
```
